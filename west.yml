## west.yml
```yaml
manifest:
  defaults:
    remote: zephyrproject

  remotes:
    - name: zephyrproject
      url-base: https://github.com/zephyrproject-rtos

  projects:
    - name: zephyr
      repo-path: zephyr
      remote: zephyrproject
      revision: v4.3.0
      clone-depth: 1
      import:
        name-allowlist:
          - picolibc
          - hal_espressif
          - hal_st
```
